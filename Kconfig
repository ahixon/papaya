## Kconfig
```kconfig
mainmenu "Project Configuration"


source "kernel/Kconfig"


source libs/Kconfig
source apps/Kconfig
source "$COMMON_PATH/Kconfig"
```

## apps/Kconfig
```kconfig
config SEL4_APPS_PATH
    string
    option env="SEL4_APPS_PATH"

menu "seL4 Applications"

source "$SEL4_APPS_PATH/sos/Kconfig"
source "$SEL4_APPS_PATH/sos_test/Kconfig"
source "$SEL4_APPS_PATH/sosh/Kconfig"
source "$SEL4_APPS_PATH/tty_test/Kconfig"

menu "Devices"
source "$SEL4_APPS_PATH/dev_console/Kconfig"
source "$SEL4_APPS_PATH/dev_timer/Kconfig"
endmenu


menu "Services"
source "$SEL4_APPS_PATH/svc_network/Kconfig"
source "$SEL4_APPS_PATH/svc_vfs/Kconfig"
source "$SEL4_APPS_PATH/svc_dev/Kconfig"

menu "Filesystems"
source "$SEL4_APPS_PATH/fs_dev/Kconfig"
source "$SEL4_APPS_PATH/fs_cpio/Kconfig"
endmenu
endmenu

endmenu
```

## apps/dev_console/Kconfig
```kconfig
config APP_DEV_CONSOLE
    bool "Console device"
    depends on LIB_SEL4 && LIB_SEL4_C && LIB_SOS && LIB_PAWPAW
    default y
    select HAVE_SEL4_APPS
    select APP_SVC_NET
    help
        Console device server
```

## apps/dev_timer/Kconfig
```kconfig
config APP_DEV_TIMER
    bool "Timer device"
    depends on LIB_SEL4 && LIB_SEL4_C && LIB_SOS && LIB_PAWPAW
    default y
    select HAVE_SEL4_APPS
    help
        Timer device server (uses GPT)
```

## apps/forkbomb/Kconfig
```kconfig
config APP_FORKBOMB
    bool "Forkbomb app"
    depends on LIB_SEL4 && LIB_SEL4_C && LIB_SOS && LIB_PAWPAW
    select HAVE_SEL4_APPS
    help
        A recursive app(A recursive app(A recursive app(A recursive app)))
```

## apps/fs_cpio/Kconfig
```kconfig
config APP_FS_CPIO
    bool "CPIO filesystem"
    depends on LIB_SEL4 && LIB_SEL4_C && LIB_SOS
    default n
    select HAVE_SEL4_APPS
    help
        CPIO file system server. Required to mount filesystem containing optional "core" startup services.
```

## apps/fs_dev/Kconfig
```kconfig
config APP_FS_DEV
    bool "Device filesystem"
    depends on LIB_SEL4 && LIB_SEL4_C && LIB_PAWPAW
    default y
    select HAVE_SEL4_APPS
    select APP_SVC_VFS
    select APP_SVC_DEV
    help
        Device file system server
```

## apps/fs_nfs/Kconfig
```kconfig
config APP_FS_NFS
    bool "NFS filesystem"
    depends on LIB_SEL4 && LIB_SEL4_C && LIB_SOS && LIB_PAWPAW && LIB_NFS && LIB_SEL4_SYNC
    default y
    select HAVE_SEL4_APPS
    select APP_SVC_VFS
    help
        NFS file system server.
```

## apps/sos/Kconfig
```kconfig
config APP_SOS
    bool "Papaya"
    select LIB_SEL4 
    select LIB_SEL4_C
    select LIB_SEL4_ELF
    select LIB_CPIO
    select LIB_SEL4_CSPACE 
    select LIB_IXP400_XSCALE_SW if IXP400
    select LIB_IXP_OSAL if IXP400
    select LIB_SOS
    select LIB_PAWPAW
    default y
    help
        Simple Operating System (aka AOS implementation)
```

## apps/sos_test/Kconfig
```kconfig
config APP_SOS_TEST
    bool "SOS tests"
    depends on LIB_SEL4 && LIB_SEL4_C && LIB_SOS && LIB_PAWPAW
    default n
    select HAVE_SEL4_APPS
    help
        Several userland tests for SOS.
```

## apps/sosh/Kconfig
```kconfig
config APP_SOSH
    bool "SOSH"
    depends on LIB_SEL4 && LIB_SEL4_C && LIB_SOS && LIB_PAWPAW
    default y
    select HAVE_SEL4_APPS
    help
        Simple shell built upon the Simple Operating System
```

## apps/svc_dev/Kconfig
```kconfig
config APP_SVC_DEV
    bool "Device service"
    depends on LIB_SEL4 && LIB_SEL4_C && LIB_PAWPAW
    default n
    select HAVE_SEL4_APPS
    help
        Device server
```

## apps/svc_net/Kconfig
```kconfig
menuconfig APP_SVC_NET
    bool "Networking service"
    depends on LIB_SEL4 && LIB_SEL4_C && LIB_ETHIF && LIB_LWIP
    default y
    select HAVE_SEL4_APPS
    help
        Network service server

config SOS_NETMASK
    string "Network mask"
    depends on APP_SVC_NET
    default "225.225.225.0"

config SOS_IP
    string "IP address"
    depends on APP_SVC_NET
    default "192.168.168.2"

config SOS_GATEWAY
    string "Gateway IP address"
    depends on APP_SVC_NET
    default "192.168.168.1"

config SOS_NFS_DIR
    string "NFS directory"
    depends on APP_SVC_NET
    default "/var/tftpboot/USER"
```

## apps/svc_network/Kconfig
```kconfig
config APP_SVC_NETWORK
    bool "Networking service"
    depends on LIB_SEL4 && LIB_SEL4_C && LIB_SOS
    default n
    select HAVE_SEL4_APPS
    help
        Network service server
```

## apps/svc_vfs/Kconfig
```kconfig
config APP_SVC_VFS
    bool "Virtual file system service"
    depends on LIB_SEL4 && LIB_SEL4_C && LIB_PAWPAW && LIB_SOS
    default y
    select HAVE_SEL4_APPS
    help
        VFS server
```

## apps/test_echoserver/Kconfig
```kconfig
config APP_TEST_ECHOSERVER
    bool "UDP echo test"
    depends on LIB_SEL4 && LIB_SEL4_C && LIB_SOS && LIB_PAWPAW
    default n
    select APP_SVC_NET
    select HAVE_SEL4_APPS
    help
        Runs an echo server over UDP.
```

## apps/test_runner/Kconfig
```kconfig
config APP_TEST_RUNNER
    bool "Test runner"
    depends on LIB_SEL4 && LIB_SEL4_C && LIB_SOS && LIB_PAWPAW
    default n
    select HAVE_SEL4_APPS
    help
        Test runner. Runs all the other test applications.
```

## apps/test_share_a/Kconfig
```kconfig
config APP_TEST_SHARE_A
    bool "Shared buffer test (client A)"
    depends on LIB_SEL4 && LIB_SEL4_C && LIB_SOS && LIB_PAWPAW
    default n
    select HAVE_SEL4_APPS
    help
        Client A that sends and receives stuff in a buffer. This is the first one that should run.
```

## apps/test_share_b/Kconfig
```kconfig
config APP_TEST_SHARE_B
    bool "Shared buffer test (client B)"
    depends on LIB_SEL4 && LIB_SEL4_C && LIB_SOS && LIB_PAWPAW
    default n
    select HAVE_SEL4_APPS
    help
        Client B that sends and receives stuff in a buffer. Started by client A.
```

## apps/thrash/Kconfig
```kconfig
config APP_THRASH
    bool "Page thrasher"
    depends on LIB_SEL4 && LIB_SEL4_C && LIB_SOS && LIB_PAWPAW
    default n
    select HAVE_SEL4_APPS
    help
        Surely you could just download more RAM?
```

## apps/tty_test/Kconfig
```kconfig
config APP_TTY_TEST
    bool "TTY test"
    depends on LIB_SEL4 && LIB_SEL4_C && LIB_SOS
    default y
    select HAVE_SEL4_APPS
    help
        A test program for printing over serial for AOS
```

## kernel/Kconfig
```kconfig
config HAVE_DOT_CONFIG
	bool
	default y
config ARCH_ARM_V7A
	bool
	default y
config KERNEL_SEARCHABLE_CDT
	bool
	default y
config ARCH_ARM
	bool
	default y
config ARM_CORTEX_A9
	bool
	default y
config PLAT_IMX6
	bool
	default y
config ROOT_CNODE_SIZE_BITS
	int
	default 12
config TIME_SLICE
	int
	default 5
config RETYPE_FAN_OUT_LIMIT
	int
	default 256
config MAX_WORK_UNITS_PER_PREEMPTION
	int
	default 100
config MAX_NUM_BOOTINFO_DEVICE_REGIONS
	int
	default 199
config MAX_NUM_BOOTINFO_UNTYPED_CAPS
	int
	default 167
config DEBUG_BUILD
	bool
	default y
config OPTIMISATION_O2
	bool
	default y
config KERNEL_PATH
    string
    option env=KERNEL_ROOT_PATH

config COMMON_PATH
    string
    option env=COMMON_PATH
```

## libs/Kconfig
```kconfig
config SEL4_LIBS_PATH
    string
    option env="SEL4_LIBS_PATH"

config HAVE_SEL4_LIBS
    bool

menu "seL4 Libraries"

source "$SEL4_LIBS_PATH/libsel4c/Kconfig"
source "$SEL4_LIBS_PATH/libsel4/Kconfig"
source "$SEL4_LIBS_PATH/libsel4cspace/Kconfig"
source "$SEL4_LIBS_PATH/libsel4sync/Kconfig"
source "$SEL4_LIBS_PATH/liblwip/Kconfig"
source "$SEL4_LIBS_PATH/libserial/Kconfig"
source "$SEL4_LIBS_PATH/libnfs/Kconfig"
source "$SEL4_LIBS_PATH/libclock/Kconfig"
source "$SEL4_LIBS_PATH/libsel4elf/Kconfig"
source "$SEL4_LIBS_PATH/elfloader/Kconfig"
source "$SEL4_LIBS_PATH/libcpio/Kconfig"
source "$SEL4_LIBS_PATH/libethdrivers/Kconfig"

source "$SEL4_LIBS_PATH/libsos/Kconfig"



endmenu
```

## libs/elfloader/Kconfig
```kconfig
# @LICENSE(NICTA_CORE)

menuconfig LIB_ELFLOADER
    bool "Build elfloader"
    default y
    depends on ARCH_ARM
    select LIB_CPIO

config ARM_ERRATA_764369
    bool "Workaround for ARM errata 764369"
    depends on LIB_ELFLOADER
    default y
    help
        Work around for a Cortex-A9 errata. Workaround stole wholesale from Linux kernel    
```
