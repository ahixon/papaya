## libs/libclock/Kconfig
```kconfig
config LIB_CLOCK
    bool "Build libclock"
    select LIB_SEL4 
    select LIB_SEL4_C
    select HAVE_SEL4_LIBS
    default y
    help
        "Basic clock interfaces for seL4 sos"
```

## libs/libcpio/Kconfig
```kconfig
# @LICENSE(NICTA_CORE)

config LIB_CPIO
    bool "CPIO library"
    default y
    help
        Library for parsing ".cpio" file headers.
```

## libs/libethdrivers/Kconfig
```kconfig
# @LICENSE(NICTA_CORE)

config LIB_ETHIF
    bool "Build ethernet interface library"
    depends on HAVE_LIBC
    default y
```

## libs/liblwip/Kconfig
```kconfig
config LIB_LWIP
    bool "Build LwIP"
    depends on HAVE_LIBC
    default y
    help
        Lighweight TPC/IP network stack library.
```

## libs/libnfs/Kconfig
```kconfig
config LIB_NFS
    bool "Build libnfs"
    depends on LIB_PAWPAW
    select LIB_SEL4 
    select LIB_SEL4_C
    select LIB_LWIP 
    select LIB_SEL4_SYNC
    select APP_SVC_NET
    select HAVE_SEL4_LIBS
    default y
    help
        "Basic NFS library for Papaya"
```

## libs/libpawpaw/Kconfig
```kconfig
config LIB_PAWPAW
    bool "Build libpawpaw"
    select HAVE_SEL4_LIBS
    default y
    help
        "Library for userspace CNode management, and general mailbox routines."
```

## libs/libsel4/Kconfig
```kconfig
# @LICENSE(NICTA_CORE)

config LIB_SEL4
    bool "Build sel4 library"
    depends on HAVE_LIBC
    default y
    help
        "Build the sel4 library"
```

## libs/libsel4c/Kconfig
```kconfig
# @LICENSE(NICTA_CORE)

config LIB_SEL4_C
    bool "Build seL4 std C library"
    default y
    select HAVE_LIBC
    help
        Build stdc library for seL4

config HAVE_LIBC
    bool
    default y
    depends on LIB_SEL4_C || LIB_MUSL_C
```

## libs/libsel4elf/Kconfig
```kconfig
# @LICENSE(NICTA_CORE)

config LIB_SEL4_ELF
    bool "seL4 ELF manipulation library"
    depends on HAVE_LIBC
    default y
    help
        seL4 ELF related library
```

## libs/libserial/Kconfig
```kconfig
config LIB_SERIAL
    bool "Build libserial"
    select LIB_SEL4 
    select LIB_SEL4_C
    select LIB_LWIP
    select HAVE_SEL4_LIBS
    default y
    help
        "Basic serial library for seL4 sos"
```

## libs/libsos/Kconfig
```kconfig
config LIB_SOS
    bool "Build sos library"
    select HAVE_SEL4_LIBS
    select LIB_PAWPAW
    default y
    help
        "C platform dependant function implementations for sos clients"
```

## tools/common/Kconfig
```kconfig
# @LICENSE(NICTA_CORE)

# This options are imported into the top-level project of all projects.
menu "Toolchain Options"
    config CROSS_COMPILER_PREFIX
        string "Cross compiler prefix"
    default "arm-linux-gnueabi-" if ARCH_ARM
    default "i686-pc-linux-gnu-" if ARCH_I386
    default ""
        help
            Set the cross compiler prefix, like arm-linux-gnueabi-
            Ensure the compiler is in your PATH or include the full
            path of the compiler in the prefix, such as
            /opt/toolchains/gcc4/arm-linux-gnueabi-

    config KERNEL_COMPILER
        string "Path to a different compiler to use for the kernel"
    default ""
        help
            If you set this option to a non-empty string, this compiler will be
            used for compiling the kernel. The compiler specified by your
            cross-compiler prefix will still be used for user-space. Note that
            this option does not affect the pre-processor, assembler or linker
            used on the kernel.

    config KERNEL_CFLAGS
        string "Compiler flags to use for compiling the kernel."
    default ""
        help
            Setting this option to a non-empty string overrides the default
            flags (and those you have selected elsewhere in the build
            configuration) that are passed to the compiler when compiling the
            kernel. This does not affect the compiler flags passed when
            compiling user-space.

            Use this option with care as it will prevent several sane default
            options that are normally passed. Note that this does not prevent
            DEFINES being passed to the compiler. This causes the pre-processor
            invocations in the kernel to assume they are targetting a non-GNU
            compiler. It does not affect the assembling or linking of the
            kernel.

    config KERNEL_EXTRA_CPPFLAGS
        string "Extra CPP flags to use for compiling the kernel."
        default ""
        help
            These flags will be appended to the C pre-processor flags used when
            compiling the kernel. Note these will not be applied during
            user-space pre-processing.

    config USER_DEBUG_INFO
        bool "Emit debugging information"
        default y
        help
            Emit debugging information when compiling applications and
            libraries. This does not affect the compiler flags applied to the
            kernel.

    config USER_EXTRA_CFLAGS
        string "Extra userspace CFLAGS"
        default ""
        help
            Extra flags to append when compiling applications and libraries.
            This does not affect the flags applied when compiling the kernel.

    config USER_CFLAGS
        string "Override userspace CFLAGS"
        default ""
        help
            A set of flags to be used as the ONLY options when compiling
            applications and libraries. This does not affect the flags applied
            when compiling the kernel. This option takes precedence over "Extra
            userspace CFLAGS" and should be used with care.

    config BUILDSYS_USE_CCACHE
        bool "Use ccache to improve build performance"
        default y
        help
            ccache will cache object files based on compiler name, compile flags
            and source file name. On the next attempt to compile this file with
            the same compiler and flags, the object file will be copied from the
            cache rather than compiling from source.

    config BUILDSYS_USE_GOANNA
        bool "Use Goanna for static analysis"
        default y
        help
            Goanna is a static analysis tool developed internally. Select this
            option to enable it during compilation if you have it installed.

    config BUILDSYS_GOANNA_PROFILE
        string "Goanna profile"
        default ""
        depends on BUILDSYS_USE_GOANNA
        help
            Goanna needs a profile file describing the behaviour of your
            compiler. Set this value to the profile file that describes your
            cross-compiler.

endmenu
```
